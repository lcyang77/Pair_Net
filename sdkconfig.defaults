## sdkconfig.defaults
```kconfig
CONFIG_ESPTOOLPY_FLASHSIZE_2MB=y

CONFIG_PARTITION_TABLE_CUSTOM=y
CONFIG_PARTITION_TABLE_CUSTOM_FILENAME="partitions.csv"
CONFIG_PARTITION_TABLE_FILENAME="partitions.csv"
CONFIG_PARTITION_TABLE_OFFSET=0x8000
CONFIG_PARTITION_TABLE_MD5=y

CONFIG_BOOTLOADER_LOG_LEVEL_ERROR=y
CONFIG_BOOTLOADER_LOG_LEVEL=1
CONFIG_LOG_BOOTLOADER_LEVEL_ERROR=y
CONFIG_LOG_BOOTLOADER_LEVEL=1

#CONFIG_LOG_DEFAULT_LEVEL_WARN=y
#CONFIG_LOG_DEFAULT_LEVEL=2

CONFIG_BT_ENABLED=y
CONFIG_BTDM_CTRL_MODE_BLE_ONLY=y
CONFIG_BTDM_CTRL_MODE_BR_EDR_ONLY=n
CONFIG_BTDM_CTRL_MODE_BTDM=n
CONFIG_BT_BLUEDROID_ENABLED=n
CONFIG_BT_NIMBLE_ENABLED=y

CONFIG_FREERTOS_UNICORE=y
CONFIG_FREERTOS_ASSERT_ON_UNTESTED_FUNCTION=n
CONFIG_FREERTOS_ASSERT_FAIL_ABORT=n
CONFIG_FREERTOS_ASSERT_DISABLE=y

#CONFIG_FREERTOS_HZ=1000

CONFIG_COMPILER_OPTIMIZATION_SIZE=y
CONFIG_COMPILER_OPTIMIZATION_ASSERTIONS_SILENT=y

CONFIG_ESP32C2_XTAL_FREQ_26=y
CONFIG_XTAL_FREQ_26=y

CONFIG_CONSOLE_UART_BAUDRATE=115200

CONFIG_ESP_SYSTEM_EVENT_TASK_STACK_SIZE=2048
CONFIG_ESP_MAIN_TASK_STACK_SIZE=3072
CONFIG_ESP_TIMER_TASK_STACK_SIZE=2048
CONFIG_FREERTOS_TIMER_TASK_STACK_DEPTH=2048
CONFIG_MDNS_TASK_STACK_SIZE=3072
CONFIG_BT_LE_CONTROLLER_TASK_STACK_SIZE=2048
CONFIG_BT_NIMBLE_HOST_TASK_STACK_SIZE=3072

CONFIG_BT_LE_CONTROLLER_TASK_STACK_SIZE=2048
CONFIG_FREERTOS_IDLE_TASK_STACKSIZE=768
CONFIG_FREERTOS_TIMER_TASK_STACK_DEPTH=1536
```
